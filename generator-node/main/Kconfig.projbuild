## generator-node/main/Kconfig.projbuild
```kconfig
menu "Generator node"

    comment "RMII wiring — defaults match the ESP32-P4-Function-EV-Board's onboard IP101"

    config GENERATOR_ETH_MDC_GPIO
        int "RMII MDC GPIO"
        range 0 56
        default 31

    config GENERATOR_ETH_MDIO_GPIO
        int "RMII MDIO GPIO"
        range 0 56
        default 52

    config GENERATOR_ETH_PHY_ADDR
        int "PHY address"
        range 0 31
        default 1

    config GENERATOR_ETH_PHY_RST_GPIO
        int "PHY reset GPIO (-1 if not wired)"
        range -1 56
        default 51

    config GENERATOR_ETH_PHY_POWER_GPIO
        int "PHY power / oscillator-enable GPIO (-1 if not wired)"
        range -1 56
        default -1
        help
            Some boards gate the PHY's power or 50 MHz oscillator behind a
            GPIO. Set it here so it is driven high before the Ethernet driver
            probes the PHY. Not needed on the ESP32-P4-Function-EV-Board
            (onboard IP101 doesn't gate power this way).

    comment "Blocklist sources"

    config GENERATOR_SOURCE_URL_1
        string "Source URL 1"
        default "https://raw.githubusercontent.com/StevenBlack/hosts/master/hosts"

    config GENERATOR_SOURCE_URL_2
        string "Source URL 2 (empty to disable)"
        default "https://big.oisd.nl/domainswild"

    config GENERATOR_SOURCE_URL_3
        string "Source URL 3 (empty to disable)"
        default "https://raw.githubusercontent.com/AdguardTeam/AdguardSDNSFilter/master/Filters/filter.txt"
        help
            Three fixed slots rather than an editable list — Kconfig doesn't
            do arrays cleanly, and this set is human-curated and slow-
            changing, same reasoning as CONFIG_SINKHOLE_MANIFEST_URL being a
            single build-time string in the sinkhole firmware. A dead source
            (wrong URL, empty slot, HTTP error) is skipped, not fatal — see
            fetch.c.

    config GENERATOR_MIN_DOMAINS
        int "Minimum domains (refuse-to-publish floor)"
        default 10000
        help
            Must match BLOCKLIST_MIN_DOMAINS in main/blocklist.h — the
            DNS-sinkhole firmware enforces the same floor before accepting
            a downloaded list.

    config GENERATOR_REFRESH_INTERVAL_S
        int "Refresh interval (seconds)"
        default 21600
        help
            How often to re-fetch all sources and regenerate. Default 6h,
            matching generator/config.example.json.

    comment "HTTP serving"

    config GENERATOR_HTTP_PORT
        int "HTTP port"
        range 1 65535
        default 80

    config GENERATOR_PUBLIC_URL_BASE
        string "Public URL base (empty = use this node's own detected IP)"
        default ""
        help
            The address DNS-sinkhole nodes reach this node at — goes into
            the manifest's "url" field. Leave empty to use
            http://<this node's DHCP IP>:<GENERATOR_HTTP_PORT>, which is
            correct as long as the node's IP is stable (static/DHCP
            reservation). Set explicitly if this node is reachable at a
            different address (DNS name, NAT, etc).

endmenu
```

## generator-node/sdkconfig.defaults
```kconfig
# Generator-node firmware: ESP32-P4-Function-EV-Board, onboard IP101 RMII
# PHY (see main/idf_component.yml + Kconfig.projbuild defaults), 32 MB PSRAM,
# 32 MB flash. Separate ESP-IDF project from the sinkhole firmware (../) —
# see CLAUDE.md's "Firmware roles" section for why.
CONFIG_IDF_TARGET="esp32p4"

# Same pre-mass-production-silicon workaround as the sinkhole build (rev
# v1.3 board; IDF's default REV_MIN is v3.1). Drop back to the IDF default if
# this ever runs on rev3+ silicon.
CONFIG_ESP32P4_SELECTS_REV_LESS_V3=y
CONFIG_ESP32P4_REV_MIN_100=y

CONFIG_SPIRAM=y
CONFIG_SPIRAM_SPEED_200M=y

CONFIG_ESPTOOLPY_FLASHSIZE_32MB=y
CONFIG_PARTITION_TABLE_CUSTOM=y
CONFIG_PARTITION_TABLE_CUSTOM_FILENAME="partitions.csv"

# Panic (and therefore reboot) rather than hang if anything faults.
CONFIG_ESP_SYSTEM_PANIC_PRINT_REBOOT=y

# HTTPS fetch from public blocklist sources (GitHub-raw, oisd.nl, …) needs the
# full CA bundle — more host diversity than the sinkhole's single manifest
# host, so keep the default (full) bundle rather than trimming it.
CONFIG_MBEDTLS_CERTIFICATE_BUNDLE=y

# HTTP server: manifest.json/blocklist.bin/healthz/refresh/stats. Port 80 so
# a plain http://<node-ip>/manifest.json works with no port in the URL.
CONFIG_GENERATOR_HTTP_PORT=80

# Best-effort UDP node-stats collector + GET /stats, /stats/ui/ — see
# main/stats.c and generator-node/main/stats_ui.c. Point sinkhole nodes'
# CONFIG_SINKHOLE_STATS_HOST at this node's IP to feed it.
CONFIG_GENERATOR_STATS_ENABLE=y
CONFIG_GENERATOR_STATS_PORT=8094

# CONFIG_GENERATOR_ALLOWLIST is intentionally left at its empty default here
# — set your own "never block" domains in a gitignored sdkconfig.local
# instead of committing them, e.g.:
#   CONFIG_GENERATOR_ALLOWLIST="example.com,mybank.example"
```

## main/Kconfig.projbuild
```kconfig
menu "DNS sinkhole"

    comment "RMII wiring — set these to match your board"
    comment "(defaults are LAN8720 on plain ESP32 / onboard IP101 on the ESP32-P4-Function-EV-Board)"

    config SINKHOLE_ETH_MDC_GPIO
        int "RMII MDC GPIO"
        range 0 56
        default 31 if IDF_TARGET_ESP32P4
        default 23

    config SINKHOLE_ETH_MDIO_GPIO
        int "RMII MDIO GPIO"
        range 0 56
        default 52 if IDF_TARGET_ESP32P4
        default 18

    config SINKHOLE_ETH_PHY_ADDR
        int "PHY address"
        range 0 31
        default 1

    config SINKHOLE_ETH_PHY_RST_GPIO
        int "PHY reset GPIO (-1 if not wired)"
        range -1 56
        default 51 if IDF_TARGET_ESP32P4
        default -1

    config SINKHOLE_ETH_PHY_POWER_GPIO
        int "PHY power / oscillator-enable GPIO (-1 if not wired)"
        range -1 56
        default -1
        help
            Some boards gate the PHY's power or 50 MHz oscillator behind a
            GPIO (e.g. GPIO16 on WT32-ETH01-style wiring). Set it here so it
            is driven high before the Ethernet driver probes the PHY. Not
            needed on the ESP32-P4-Function-EV-Board (onboard IP101 doesn't
            gate power this way).

    comment "List updates"

    config SINKHOLE_MANIFEST_URL
        string "Blocklist manifest URL"
        default "http://esphole.local:8080/manifest.json"
        help
            Where the generator serves manifest.json. The blocklist blob
            itself is fetched from the manifest's "url" field, so this is
            the only address the updater needs.

    comment "Monitoring (UDP stats reports to the generator)"

    config SINKHOLE_STATS_ENABLE
        bool "Report query stats to a monitoring server"
        default y
        help
            Best-effort monitoring: a low-priority task sends one UDP
            datagram (InfluxDB line protocol) every interval with query
            counts and latency histogram deltas. Send failures are dropped
            silently — this can never affect DNS serving. Disable to compile
            the stats module out entirely.

    config SINKHOLE_STATS_HOST
        string "Stats server host"
        depends on SINKHOLE_STATS_ENABLE
        default "esphole.local"
        help
            Hostname or IPv4 literal of the generator server (its
            stats_listen UDP port). An IP literal avoids depending on LAN
            DNS to resolve .local names.

    config SINKHOLE_STATS_PORT
        int "Stats server UDP port"
        depends on SINKHOLE_STATS_ENABLE
        range 1 65535
        default 8094

    config SINKHOLE_STATS_INTERVAL_S
        int "Stats send interval (seconds)"
        depends on SINKHOLE_STATS_ENABLE
        range 1 3600
        default 10

endmenu
```

## sdkconfig.defaults
```kconfig
# ESP32-P4-Function-EV-Board: onboard IP101 RMII PHY (see main/idf_component.yml
# + Kconfig.projbuild defaults), 32 MB PSRAM over the dedicated (non-SPI)
# memory interface, 32 MB flash.
CONFIG_IDF_TARGET="esp32p4"

# This dev board carries pre-mass-production ESP32-P4 silicon (rev v1.3).
# ESP-IDF's default REV_MIN is v3.1 (mass-production silicon has real
# hardware differences from early samples per esp_hw_support's Kconfig, e.g.
# a rev3-only MSPI workaround) so the default bootloader refuses to boot on
# this chip. Lower the floor to match the actual hardware. If you swap in a
# rev3+ board, this can be dropped back to the IDF default.
CONFIG_ESP32P4_SELECTS_REV_LESS_V3=y
CONFIG_ESP32P4_REV_MIN_100=y

# P4's PSRAM interface tops out higher than the ESP32's quad SPI PSRAM;
# 200 MHz is the speed used by Espressif's own P4 examples.
CONFIG_SPIRAM=y
CONFIG_SPIRAM_SPEED_200M=y

# The board ships 32 MB flash (confirmed via esptool detected size, not just
# the datasheet); use it. partitions.csv grows the blocklist slots to 2x 14 MB
# (~1.8M domains each) and leaves the tail free for dual OTA app partitions
# later.
CONFIG_ESPTOOLPY_FLASHSIZE_32MB=y
CONFIG_PARTITION_TABLE_CUSTOM=y
CONFIG_PARTITION_TABLE_CUSTOM_FILENAME="partitions.csv"

# Panic (and therefore reboot) rather than hang if anything faults — this is
# network-critical infrastructure and a reboot is the fail-safe.
CONFIG_ESP_SYSTEM_PANIC_PRINT_REBOOT=y

# HTTPS for manifest/blocklist downloads uses the built-in CA bundle.
CONFIG_MBEDTLS_CERTIFICATE_BUNDLE=y
```

## sdkconfig.defaults.esp32p4
```kconfig
# Applied on top of sdkconfig.defaults when CONFIG_IDF_TARGET=esp32p4 (idf.py
# set-target esp32p4). Targets the official ESP32-P4-Function-EV-Board:
# onboard IP101 RMII PHY (see main/idf_component.yml + Kconfig.projbuild
# defaults), 32 MB PSRAM over the dedicated (non-SPI) memory interface.
CONFIG_IDF_TARGET="esp32p4"

# This dev board carries pre-mass-production ESP32-P4 silicon (rev v1.3).
# ESP-IDF's default REV_MIN is v3.1 (mass-production silicon has real
# hardware differences from early samples per esp_hw_support's Kconfig, e.g.
# a rev3-only MSPI workaround) so the default bootloader refuses to boot on
# this chip. Lower the floor to match the actual hardware. If you swap in a
# rev3+ board, this can be dropped back to the IDF default.
CONFIG_ESP32P4_SELECTS_REV_LESS_V3=y
CONFIG_ESP32P4_REV_MIN_100=y

# P4's PSRAM interface tops out higher than the ESP32's quad SPI PSRAM;
# 200 MHz is the speed used by Espressif's own P4 examples.
CONFIG_SPIRAM_SPEED_200M=y

# The board ships 32 MB flash (confirmed via esptool detected size, not just
# the datasheet); use it. partitions.esp32p4.csv grows the blocklist slots to
# 2x 14 MB (~1.8M domains each) and leaves the tail free for dual OTA app
# partitions later.
CONFIG_ESPTOOLPY_FLASHSIZE_32MB=y
CONFIG_PARTITION_TABLE_CUSTOM_FILENAME="partitions.esp32p4.csv"
```
